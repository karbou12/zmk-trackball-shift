/*
 * Copyright (c) 2026 Tano Karbou (github: karbou12 / X: @karbou_12)
 *
 * SPDX-License-Identifier: MIT
 */

#include <dt-bindings/zmk/behaviors.h>

/ {
    behaviors {
#if ZMK_BEHAVIOR_OMIT(TBR)
        /omit-if-no-ref/
#endif
        tb_reset: tb_reset {
            compatible = "zmk,behavior-trackball-shift-reset";
            #binding-cells = <0>;
            display-name = "Trackball Shift Reset Device Angle";
        };
    };
};
