## Kconfig
```kconfig
# Copyright (c) 2026 Tano Karbou (github: karbou12 / X: @karbou_12)
# SPDX-License-Identifier: MIT

config ZMK_TRACKBALL_SHIFT
    bool
    default y
    depends on ZMK_POINTING
    depends on (!ZMK_SPLIT || ZMK_SPLIT_ROLE_CENTRAL)
    help
        Enable Trackball Shift for ZMK.

if ZMK_TRACKBALL_SHIFT

config ZMK_TRACKBALL_SHIFT_DIRECTION_ANGLE_DEG
    int "Angle [deg] of each direction for trackball shift."
    default 45
    range 3 45
    help
        This value must be a divisor of 360.

config ZMK_TRACKBALL_SHIFT_ROTATION_SAMPLE_TIME_MS
    int "Sample time [ms] for rotation behavior."
    default 3000
    help
        Used for handling multiple inputs from a rotary encoder.
        If the encoder's step angle is smaller than direction_angle_deg,
        steps are accumulated within the sample time.
        Once the accumulated angle exceeds direction_angle_deg, the system triggers a rotation of direction_angle_deg.
        If the threshold is not exceeded within this time, the accumulated steps are reset.

config ZMK_TRACKBALL_SHIFT_DISTANCE_THRESHOLD
    int "Threshold of distance for direction detection of trackball shift"
    default 800

config ZMK_TRACKBALL_SHIFT_DETECTION_SAMPLE_TIME_MS
    int "Sample time [ms] for direction detection of trackball shift"
    default 100

module = TRACKBALL_SHIFT
module-str = TRACKBALL_SHIFT
source "${ZEPHYR_BASE}/subsys/logging/Kconfig.template.log_config"

endif # ZMK_TRACKBALL_SHIFT
```

## dts/bindings/behaviors/zmk,behavior-trackball-direction-detection.yaml
```yaml
# Copyright (c) 2026 Tano Karbou (github: karbou12 / X: @karbou_12)
# SPDX-License-Identifier: MIT

description: trackball shift direction detection behavior

compatible: "zmk,behavior-trackball-direction-detection"

include: zero_param.yaml
```

## dts/bindings/behaviors/zmk,behavior-trackball-shift-reset.yaml
```yaml
# Copyright (c) 2026 Tano Karbou (github: karbou12 / X: @karbou_12)
# SPDX-License-Identifier: MIT

description: reset trackball shift device angle

compatible: "zmk,behavior-trackball-shift-reset"

include: zero_param.yaml
```

## dts/bindings/behaviors/zmk,behavior-trackball-shift-rotation.yaml
```yaml
# Copyright (c) 2026 Tano Karbou (github: karbou12 / X: @karbou_12)
# SPDX-License-Identifier: MIT

description: trackball shift cw/ccw rotation behavior

compatible: "zmk,behavior-trackball-shift-rotation"

include: two_param.yaml
```

## dts/bindings/input_processors/zmk,input-processor-trackball-direction-detection.yaml
```yaml
# Copyright (c) 2026 Tano Karbou (github: karbou12 / X: @karbou_12)
# SPDX-License-Identifier: MIT

description: Input Processor for detecion the direction of trackball device

compatible: "zmk,input-processor-trackball-direction-detection"

include: ip_zero_param.yaml
```

## dts/bindings/input_processors/zmk,input-processor-trackball-shift.yaml
```yaml
# Copyright (c) 2026 Tano Karbou (github: karbou12 / X: @karbou_12)
# SPDX-License-Identifier: MIT

description: Input Processor for rotation xy input of trackball device

compatible: "zmk,input-processor-trackball-shift"

include: ip_zero_param.yaml

properties:
  default-device-angle-degree:
    description: |
      default device angle [deg] for trackball shift.
      if non-zero, this value must be a multiple of the direction_angle_deg, and a divisor of 360.
    type: int
    default: 0
```
